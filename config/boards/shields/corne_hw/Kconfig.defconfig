## config/boards/shields/corne_hw/Kconfig.defconfig
```kconfig
if SHIELD_CORNE_HW_RIGHT

config ZMK_KEYBOARD_NAME
    default "Corne HW"

config ZMK_SPLIT_ROLE_CENTRAL
    default y

endif

if SHIELD_CORNE_HW_LEFT || SHIELD_CORNE_HW_RIGHT

config ZMK_SPLIT
    default y
endif
```
